## boards/arm/pduv2/Kconfig.pduv2
```kconfig
# Copyright 2024 NXP
# SPDX-License-Identifier: Apache-2.0

config BOARD_PDUV2
	select SOC_LPC55S69_CPU0 if BOARD_PDUV2_LPC55S69_CPU0
	select SOC_PART_NUMBER_LPC55S69JBD100
```

## boards/arm/pduv2/board.yml
```yaml
board:
  name: pduv2
  vendor: nxp
  socs:
  - name: lpc55s69
    variants:
    - name: "ns"
      cpucluster: 'cpu0'
```

## boards/barco/pduv2/Kconfig.board
```kconfig
# Copyright 2024 NXP
# SPDX-License-Identifier: Apache-2.0

config BOARD_PDUV2_CPU0
	bool "PDU v2 [CPU0]"
	depends on SOC_SERIES_LPC55XXX
	select SOC_PART_NUMBER_LPC55S69JBD100
```

## boards/barco/pduv2/Kconfig.defconfig
```kconfig
# Copyright 2019,2024 NXP
# SPDX-License-Identifier: Apache-2.0

if BOARD_PDUV2_CPU0

config BOARD
	default pduv2_CPU0
endif 
```

## dts/bindings/powermodule.yaml
```yaml
description: Power module driver
compatible: "powermodule"
include: spi-device.yaml
```
